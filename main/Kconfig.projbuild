## main/Kconfig.projbuild
```kconfig
menu "Tesla Strip Configuration"

    config LED_GPIO
        int "LED GPIO Pin"
        default 5
        help
            GPIO pin connected to the WS2812 LED strip data line.

    config LED_COUNT
        int "Number of LEDs"
        default 60
        range 1 300
        help
            Number of LEDs in the strip.

    config WIFI_AP_SSID
        string "WiFi AP SSID"
        default "Tesla-Strip"
        help
            SSID for the access point.

    config WIFI_AP_PASSWORD
        string "WiFi AP Password"
        default "tesla123"
        help
            Password for the access point (min 8 characters).

    config PANDA_WIFI_PREFIX
        string "Panda WiFi SSID Prefix"
        default "panda-"
        help
            Prefix to search for Panda Commander WiFi networks.

    config PANDA_WIFI_PASSWORD
        string "Panda WiFi Password"
        default "testing123"
        help
            Password for connecting to Panda Commander.

    config COMMANDER_PORT
        int "Commander TCP Port"
        default 1338
        help
            TCP port for Commander connection.

    config WEB_SERVER_PORT
        int "Web Server Port"
        default 80
        help
            HTTP server port.

    config DEFAULT_BRIGHTNESS
        int "Default LED Brightness"
        default 128
        range 0 255
        help
            Default brightness level (0-255).

    config DEFAULT_EFFECT
        int "Default LED Effect"
        default 3
        range 0 15
        help
            Default LED effect on startup.

endmenu
```

## sdkconfig.defaults
```kconfig
# Configuration par défaut pour Car Light Sync

# WiFi
CONFIG_ESP32_WIFI_STATIC_RX_BUFFER_NUM=10
CONFIG_ESP32_WIFI_DYNAMIC_RX_BUFFER_NUM=32
CONFIG_ESP32_WIFI_DYNAMIC_TX_BUFFER_NUM=32
CONFIG_ESP32_WIFI_AMPDU_TX_ENABLED=y
CONFIG_ESP32_WIFI_AMPDU_RX_ENABLED=y

# LWIP
CONFIG_LWIP_MAX_SOCKETS=16
CONFIG_LWIP_SO_REUSE=y
CONFIG_LWIP_SO_RCVBUF=y
CONFIG_LWIP_TCP_MSS=1436
CONFIG_LWIP_TCP_WND_DEFAULT=65535
CONFIG_LWIP_TCP_RECVMBOX_SIZE=32

# HTTP Server
CONFIG_HTTPD_MAX_REQ_HDR_LEN=1024
CONFIG_HTTPD_MAX_URI_LEN=512

# FreeRTOS
CONFIG_FREERTOS_HZ=1000
CONFIG_FREERTOS_UNICORE=n

# Logging
CONFIG_LOG_DEFAULT_LEVEL_INFO=y
CONFIG_LOG_MAXIMUM_LEVEL_VERBOSE=y
CONFIG_LOG_COLORS=n
CONFIG_VEHICLE_CAN_DEBUG_EVENTS=y

# Partition
CONFIG_PARTITION_TABLE_CUSTOM=y
CONFIG_PARTITION_TABLE_CUSTOM_FILENAME="partitions.csv"

# NVS
CONFIG_NVS_ENCRYPTION=n

# Debugging / backtraces
CONFIG_ESP_SYSTEM_USE_FRAME_POINTER=y
```
